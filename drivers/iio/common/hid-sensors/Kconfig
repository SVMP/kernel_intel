## drivers/iio/common/hid-sensors/Kconfig
```kconfig
#
# Hid Sensor common modules
#
menu "Hid Sensor IIO Common"

config HID_SENSOR_IIO_COMMON
	tristate "Common modules for all HID Sensor IIO drivers"
	depends on HID_SENSOR_HUB
	select IIO_TRIGGER if IIO_BUFFER
	help
	  Say yes here to build support for HID sensor to use
	  HID sensor common processing for attributes and IIO triggers.
	  There are many attributes which can be shared among multiple
	  HID sensor drivers, this module contains processing for those
	  attributes.

endmenu
```

## drivers/iio/light/Kconfig
```kconfig
#
# Light sensors
#
menu "Light sensors"

config HID_SENSOR_ALS
	depends on HID_SENSOR_HUB
	select IIO_BUFFER
	select IIO_TRIGGERED_BUFFER
	select HID_SENSOR_IIO_COMMON
	tristate "HID ALS"
	help
	  Say yes here to build support for the HID SENSOR
	  Ambient light sensor.

endmenu
```
